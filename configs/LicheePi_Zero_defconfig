## configs/LicheePi_Zero_defconfig
```kconfig
CONFIG_ARM=y
CONFIG_ARCH_SUNXI=y
CONFIG_DEFAULT_DEVICE_TREE="sun8i-v3s-licheepi-zero"
#CONFIG_ENV_SIZE=0x20000
CONFIG_SYS_MALLOC_LEN=0x220000
CONFIG_SPL=y
CONFIG_MACH_SUN8I_V3S=y
CONFIG_DRAM_CLK=360
CONFIG_CMD_BOOTMENU=y
CONFIG_CMD_MEMINFO=y
CONFIG_BOOTDELAY=0
#CONFIG_VIDEO_LCD_MODE="x:1024,y:600,depth:16,pclk_khz:45000,le:88,ri:176,up:25,lo:20,hs:5,vs:5,sync:3,vmode:0"
#CONFIG_USE_BOOTARGS=y
#CONFIG_BOOTARGS="console=ttyS0,115200  panic=5 vt.global_cursor_default=0  rootwait root=/dev/mmcblk0p2 earlyprintk rw  init=/linuxrc"
CONFIG_USE_BOOTCOMMAND=y
#CONFIG_BOOTCOMMAND="load mmc 0:1 0x41000000 zImage; load mmc 0:1 0x41800000 sun8i-v3s-licheepi-zero-with-1024x600-lcd.dtb; bootz 0x41000000 - 0x41800000"
#CONFIG_ENV_FAT_DEVICE_AND_PART="0:auto"

CONFIG_NETDEVICES=y
CONFIG_SUN8I_EMAC=y
CONFIG_NET_RANDOM_ETHADDR=y

CONFIG_LOGLEVEL=7

# UBI
CONFIG_MTD_UBI=y
CONFIG_MTD_UBI_FASTMAP=y
CONFIG_MTD_UBI_FASTMAP_AUTOCONVERT=1
CONFIG_CMD_UBI=y
CONFIG_CMD_UBIFS=y
CONFIG_RBTREE=y
CONFIG_MTD_DEVICE=y
CONFIG_MTD_PARTITIONS=y
CONFIG_CMD_MTDPARTS=y
CONFIG_LZO=y
CONFIG_LZMA=y



#CONFIG_MMC=y
#CONFIG_MMC_SUNXI_SLOT_EXTRA=2

CONFIG_SPLASH_SCREEN=y
CONFIG_CMD_BMP=y
CONFIG_VIDEO_BPP8=y
CONFIG_VIDEO_SIMPLE=y
CONFIG_VIDEO_DT_SIMPLEFB=y
#CONFIG_VIDEO_LCD_POWER="PB4"
CONFIG_HIDE_LOGO_VERSION=y

CONFIG_DM_REGULATOR=y
CONFIG_REGULATOR_PWM=y
CONFIG_DM_PWM=y
CONFIG_PWM_SUNXI=y
CONFIG_BACKLIGHT_PWM=y


CONFIG_USB_GADGET_VBUS_DRAW=250

CONFIG_USB_MUSB_GADGET=y
CONFIG_USB_MUSB_SUNXI=y
CONFIG_USB_MUSB_DISABLE_BULK_COMBINE_SPLIT=y
CONFIG_USB_MUSB_PIO_ONLY=y
CONFIG_USB_STORAGE=y
CONFIG_CMD_USB_MASS_STORAGE=y

CONFIG_PHY=y
CONFIG_PHY_SUN4I_USB=y

CONFIG_USB_EHCI_HCD=y
CONFIG_USB_EHCI_GENERIC=y
CONFIG_USB_OHCI_HCD=y
CONFIG_USB_OHCI_GENERIC=y


#CONFIG_FASTBOOT_FLASH_MMC=y
#CONFIG_FASTBOOT_FLASH_MMC_DEV=1
#CONFIG_FASTBOOT_CMD_OEM_FORMAT=y


# ENV
CONFIG_ENV_IS_IN_FAT=n
CONFIG_ENV_IS_IN_UBI=y
CONFIG_ENV_UBI_PART="ubi0"
CONFIG_ENV_UBI_VOLUME="ubootenv"
CONFIG_ENV_UBI_VOLUME_REDUND="ubootenv2"
# BOOT
CONFIG_MTDIDS_DEFAULT="spi-nand0=0"
CONFIG_MTDPARTS_DEFAULT="mtdparts=0:2M(boot),-(ubi0)"
CONFIG_BOOTCOMMAND="ubifsmount ubi0:kernel; ubifsload $kernel_addr_r uImage; ubifsload $fdt_addr_r dtb; bootm 0x41000000 - 0x41800000"
CONFIG_USE_BOOTARGS=y
CONFIG_BOOTARGS="console=ttyS0,115200 earlyprintk panic=5 rootwait ubi.mtd=1,2048 rootfstype=ubifs root=ubi0:rootfs rw"
### NOR
## SPI
# CONFIG_SPI=y
# CONFIG_SPI_BOOT=y
# CONFIG_SUNXI_SPI=y
# CONFIG_SPL_SPI_SUPPORT=y
# CONFIG_SPL_SPI_SUNXI=y

### NAND
CONFIG_CLK=y
CONFIG_CLK_SUNXI=y
CONFIG_CLK_SUN8I_V3S=y
CONFIG_SUNXI_SPI=y
CONFIG_SPI_SUNXI=y
CONFIG_CMD_MTD=y
#CONFIG_MTD=y
CONFIG_DM_MTD=y
CONFIG_MTD_SPI_NAND=y
CONFIG_SPI=y
CONFIG_SPI_MEM=y
CONFIG_SPL_SPINAND_SUNXI=y
CONFIG_DM=y
CONFIG_DM_SPI=y
CONFIG_CMD_DM=y
CONFIG_CMD_SPI=y
CONFIG_SPL_SPINAND_SUNXI_SPL_USE_GENERIC2K_ON_UNKNOWN=y




CONFIG_CMD_FASTBOOT=y
CONFIG_FASTBOOT=y
CONFIG_USB_FUNCTION_FASTBOOT=y


CONFIG_USB_GADGET_DOWNLOAD=y

CONFIG_CMD_DFU=y
CONFIG_DFU=y
CONFIG_DFU_OVER_USB=y
CONFIG_DFU_TIMEOUT=y
#CONFIG_DFU_MMC=y
#CONFIG_DFU_SF=y
CONFIG_DFU_MTD=y
```

## configs/allwinner_s3_generic_defconfig
```kconfig
CONFIG_ARM=y
CONFIG_ARCH_SUNXI=y
CONFIG_MACH_SUN8I_S3=y

CONFIG_DEFAULT_DEVICE_TREE="sun8i-s3-generic"
CONFIG_SPL=y
CONFIG_CMD_BOOTMENU=y
CONFIG_CMD_MEMINFO=y
CONFIG_BOOTDELAY=0

CONFIG_NETDEVICES=y
CONFIG_SUN8I_EMAC=y
CONFIG_NET_RANDOM_ETHADDR=y

CONFIG_DM_SPI=y
CONFIG_SUNXI_SPI=y

CONFIG_MMC=y
CONFIG_MMC_SUNXI_SLOT_EXTRA=2
CONFIG_MMC0_CD_PIN="PF6"

CONFIG_CMD_BMP=y
CONFIG_VIDEO_BPP8=y
CONFIG_VIDEO_SIMPLE=y
CONFIG_VIDEO_DT_SIMPLEFB=y

CONFIG_DM_REGULATOR=y
CONFIG_REGULATOR_PWM=y
CONFIG_DM_PWM=y
CONFIG_PWM_SUNXI=y
CONFIG_BACKLIGHT_PWM=y
```

## configs/f1c200s_tf_defconfig
```kconfig
CONFIG_ARM=y
CONFIG_ARCH_SUNXI=y
CONFIG_SYS_TEXT_BASE=0x81700000
CONFIG_ENV_SIZE=0x8000
CONFIG_SPL=y
CONFIG_MACH_SUNIV=y
CONFIG_DRAM_CLK=200
CONFIG_DRAM_ZQ=0
CONFIG_SYS_CLK_FREQ=800000000
CONFIG_VIDEO_LCD_MODE="x:1024,y:600,depth:16,pclk_khz:45000,le:88,ri:176,up:25,lo:20,hs:5,vs:5,sync:3,vmode:0"
#CONFIG_VIDEO_LCD_MODE="x:480,y:272,depth:16,pclk_khz:10000,le:42,ri:8,up:11,lo:4,hs:1,vs:1,sync:3,vmode:0"
CONFIG_DEFAULT_DEVICE_TREE="suniv-f1c100s-lotlab-act-monitor"
CONFIG_CMD_BOOTMENU=y
CONFIG_CMD_MEMINFO=y
CONFIG_BOOTDELAY=0
CONFIG_USE_BOOTARGS=y
CONFIG_BOOTARGS="console=ttyS0,115200  panic=5 vt.global_cursor_default=0  rootwait root=/dev/mmcblk0p2 earlyprintk rw  init=/linuxrc"
CONFIG_USE_BOOTCOMMAND=y
CONFIG_BOOTCOMMAND="load mmc 0:1 0x80008000 zImage; load mmc 0:1 0x80c00000 suniv-f1c200s.dtb; bootz 0x80008000 - 0x80c00000"

CONFIG_MMC=y
CONFIG_MMC_SUNXI_SLOT_EXTRA=2

CONFIG_CMD_BMP=y
CONFIG_VIDEO_BPP8=y
#CONFIG_VIDEO_SIMPLE=y
#CONFIG_VIDEO_DT_SIMPLEFB=y


#CONFIG_USB_GADGET_VBUS_DRAW=250

#CONFIG_USB_MUSB_GADGET=y
#CONFIG_USB_MUSB_SUNXI=y
#CONFIG_USB_MUSB_DISABLE_BULK_COMBINE_SPLIT=y
#CONFIG_USB_MUSB_PIO_ONLY=y
#CONFIG_USB_STORAGE=y

CONFIG_PHY=y
CONFIG_PHY_SUN4I_USB=y
CONFIG_USB_MUSB_SUNXI=y
CONFIG_USB_MUSB_GADGET=y
CONFIG_USB_MUSB_PIO_ONLY=y
CONFIG_USB_MUSB_DISABLE_BULK_COMBINE_SPLIT=y
CONFIG_USB_GADGET_VBUS_DRAW=250

CONFIG_CMD_USB_MASS_STORAGE=y

CONFIG_CMD_FASTBOOT=y
CONFIG_FASTBOOT_FLASH_MMC=y
CONFIG_FASTBOOT_FLASH_MMC_DEV=1
CONFIG_FASTBOOT_CMD_OEM_FORMAT=y

#CONFIG_USB_EHCI_HCD=y
#CONFIG_USB_EHCI_GENERIC=y
#CONFIG_USB_OHCI_HCD=y
#CONFIG_USB_OHCI_GENERIC=y

#CONFIG_CMD_USB_MASS_STORAGE=y

#CONFIG_CMD_FASTBOOT=y
#CONFIG_FASTBOOT_FLASH_MMC=y
#CONFIG_FASTBOOT_FLASH_MMC_DEV=1
#CONFIG_FASTBOOT_CMD_OEM_FORMAT=y
CONFIG_CONS_INDEX=1
# CONFIG_NET is not set
```

## configs/uboot-tf_defconfig
```kconfig
CONFIG_ARM=y
CONFIG_ARCH_SUNXI=y
CONFIG_SYS_TEXT_BASE=0x81700000
CONFIG_ENV_SIZE=0x8000
CONFIG_SPL=y
CONFIG_MACH_SUNIV=y
CONFIG_DRAM_CLK=156
CONFIG_DRAM_ZQ=0
CONFIG_SYS_CLK_FREQ=720000000
CONFIG_VIDEO_LCD_MODE="x:480,y:272,depth:16,pclk_khz:10000,le:42,ri:8,up:11,lo:4,hs:1,vs:1,sync:3,vmode:0"
CONFIG_VIDEO_LCD_BL_PWM="PE6"
# CONFIG_VIDEO_LCD_BL_PWM_ACTIVE_LOW is not set
# CONFIG_DISTRO_DEFAULTS is not set
CONFIG_ENV_VARS_UBOOT_CONFIG=y
CONFIG_SD_BOOT=y
CONFIG_BOOTDELAY=0
CONFIG_USE_BOOTARGS=y
CONFIG_BOOTARGS="console=ttyS1,115200 panic=5 rootwait mtdparts=mmc:1M(uboot)ro,64k(dtb)ro,6M(kernel)ro,-(rootfs) root=/dev/mmcblk0p2 rw vt.global_cursor_default=0 earlyprintk  init=/sbin/mnt_overlay"
CONFIG_USE_BOOTCOMMAND=y
CONFIG_BOOTCOMMAND="load mmc 0:1 0x80008000 zImage;load mmc 0:1 0x80c00000 suniv-f1c100s-jxhmi-16m.dtb;bootz 0x80008000 - 0x80c00000"
# CONFIG_CONSOLE_MUX is not set
CONFIG_SYS_CONSOLE_IS_IN_ENV=y
CONFIG_SYS_STDIO_DEREGISTER=y
CONFIG_SPL_MMC_WRITE=y
CONFIG_SPL_MTD_SUPPORT=y
# CONFIG_SPL_POWER_SUPPORT is not set
CONFIG_CMD_BOOTZ=y
# CONFIG_CMD_ELF is not set
# CONFIG_CMD_EXPORTENV is not set
# CONFIG_CMD_IMPORTENV is not set
# CONFIG_CMD_EDITENV is not set
# CONFIG_CMD_SAVEENV is not set
# CONFIG_CMD_ENV_EXISTS is not set
# CONFIG_CMD_GPT is not set
# CONFIG_CMD_ECHO is not set
# CONFIG_CMD_ITEST is not set
# CONFIG_CMD_SOURCE is not set
# CONFIG_CMD_SETEXPR is not set
CONFIG_CMD_BMP=y
CONFIG_CMD_FS_GENERIC=y
# CONFIG_PARTITIONS is not set
CONFIG_DEFAULT_DEVICE_TREE="suniv-f1c100s-lotlab-act-monitor"
# CONFIG_ENV_IS_IN_FAT is not set
# CONFIG_NET is not set
# CONFIG_INPUT is not set
CONFIG_CONS_INDEX=2
CONFIG_FS_EXT4=y
CONFIG_EXT4_WRITE=y
CONFIG_FS_FAT=y
```
